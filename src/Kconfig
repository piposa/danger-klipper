## src/Kconfig
```kconfig
# Main Kconfig settings

mainmenu "Klipper Firmware Configuration"

config LOW_LEVEL_OPTIONS
    bool "Enable extra low-level configuration options"
    help
        Enable low-level configuration options that (if modified) may
        result in a build that does not function correctly.

choice
    prompt "Micro-controller Architecture"
    config MACH_AVR
        bool "Atmega AVR"
    config MACH_ATSAM
        bool "SAM3/SAM4/SAM E70 (Due and Duet)"
    config MACH_ATSAMD
        bool "SAMC21/SAMD21/SAMD51/SAME5x"
    config MACH_LPC176X
        bool "LPC176x (Smoothieboard)"
    config MACH_STM32
        bool "STMicroelectronics STM32"
    config MACH_HC32F460
        bool "Huada Semiconductor HC32F460"
    config MACH_RP2040
        bool "Raspberry Pi RP2040"
    config MACH_PRU
        bool "Beaglebone PRU"
    config MACH_AR100
        bool "Allwinner A64 AR100"
    config MACH_LINUX
        bool "Linux process"
    config MACH_SIMU
        bool "Host simulator"
endchoice

source "src/avr/Kconfig"
source "src/atsam/Kconfig"
source "src/atsamd/Kconfig"
source "src/lpc176x/Kconfig"
source "src/stm32/Kconfig"
source "src/hc32f460/Kconfig"
source "src/rp2040/Kconfig"
source "src/pru/Kconfig"
source "src/ar100/Kconfig"
source "src/linux/Kconfig"
source "src/simulator/Kconfig"

# Generic configuration options for serial ports
config SERIAL
    bool
config SERIAL_BOOTLOADER_SIDECHANNEL
    bool
config SERIAL_BAUD
    depends on SERIAL
    int "Baud rate for serial port" if LOW_LEVEL_OPTIONS
    default 250000
    help
        Specify the baud rate of the serial port. This should be set
        to 250000. Read the FAQ before changing this value.

# Generic configuration options for USB
config USBSERIAL
    bool
config USBCANBUS
    bool
config USB
    bool
    default y if USBSERIAL || USBCANBUS
config USB_VENDOR_ID
    default 0x1d50
config USB_DEVICE_ID
    default 0x614e
config USB_SERIAL_NUMBER_CHIPID
    depends on USB && HAVE_CHIPID
    default y
config USB_SERIAL_NUMBER
    default "12345"

menu "USB ids"
    depends on USB && LOW_LEVEL_OPTIONS
config USB_VENDOR_ID
    hex "USB vendor ID" if USBSERIAL
config USB_DEVICE_ID
    hex "USB device ID" if USBSERIAL
config USB_SERIAL_NUMBER_CHIPID
    bool "USB serial number from CHIPID" if HAVE_CHIPID
config USB_SERIAL_NUMBER
    string "USB serial number" if !USB_SERIAL_NUMBER_CHIPID
endmenu

#
#  Optional features that can be disabled (for devices with small flash sizes)
#
menu "Optional features (to reduce code size)"
    depends on HAVE_LIMITED_CODE_SIZE || LOW_LEVEL_OPTIONS
    config WANT_DEBUG
    bool "Support MCU Debug Commands"
    default y
config WANT_GPIO_ADC
    bool "Support ADCs"
    depends on HAVE_GPIO_ADC
    default y

#
# I2C Devices
#
config WANT_GPIO_I2C
    bool "Support I2C Devices"
    depends on HAVE_GPIO_I2C
    default y
config WANT_SOFTWARE_I2C
    bool "Support Software Based I2C \"bit-banging\""
    depends on HAVE_GPIO && WANT_GPIO_I2C
    default y
config WANT_MPU9250
    bool "Support MPU9250 Accelerometer"
    depends on WANT_GPIO_I2C
    default y

#
# SPI Devices
#
config WANT_GPIO_SPI
    bool "Support SPI Devices"
    depends on HAVE_GPIO_SPI
    default y
config WANT_THERMOCOUPLE
    bool "Support External Thermocouple SPI Devices"
    depends on WANT_GPIO_SPI
    default y
config WANT_ADXL345
    bool "Support ADXL345 Accelerometer"
    depends on WANT_GPIO_SPI
    default y
config WANT_LIS2DW
    bool "Support LIS2DW 3-axis Accelerometer"
    depends on WANT_GPIO_SPI
config WANT_ANGLE_SENSOR
    bool "Support Angle Sensors (A1333, AS5047D, TLE5012B)"
    depends on WANT_GPIO_SPI
    default y
config WANT_SOFTWARE_SPI
    bool "Support Software Based SPI \"bit-banging\""
    depends on HAVE_GPIO && WANT_GPIO_SPI
    default y

config WANT_GPIO_SDIO
    bool "Support SDIO Devices"
    depends on HAVE_GPIO_SDIO
    default y
config WANT_GPIO_HARD_PWM
    bool "Support Hardware PWM"
    depends on HAVE_GPIO_HARD_PWM
    default y
config WANT_BUTTONS
    bool "Support GPIO Buttons"
    depends on HAVE_GPIO
    default y
config WANT_TMCUART
    bool "Support TMC UART"
    depends on HAVE_GPIO
    default y
config WANT_NEOPIXEL
    bool "Support NeoPixels"
    depends on HAVE_GPIO
    default y
config WANT_PULSE_COUNTER
    bool "Support Pulse Counter"
    depends on HAVE_GPIO
    default y
config WANT_DISPLAYS
    bool "Support LCD Devices"
    depends on HAVE_GPIO
    default y

endmenu

# Generic configuration options for CANbus
config CANSERIAL
    bool
config CANBUS
    bool
    default y if CANSERIAL || USBCANBUS
config CANBUS_FREQUENCY
    int "CAN bus speed" if LOW_LEVEL_OPTIONS && CANBUS
    default 1000000
config CANBUS_FILTER
    bool
    default y if CANSERIAL

# Support setting gpio state at startup
config INITIAL_PINS
    string "GPIO pins to set at micro-controller startup"
    depends on LOW_LEVEL_OPTIONS
    help
        One may specify a comma separated list of gpio pins to set
        during the micro-controller startup sequence. By default the
        pins will be set to output high - preface a pin with a '!'
        character to set that pin to output low.

# The HAVE_x options allow boards to disable support for some commands
# if the hardware does not support the feature.
config HAVE_GPIO
    bool
config HAVE_GPIO_ADC
    bool
config HAVE_GPIO_SPI
    bool
config HAVE_GPIO_SDIO
    bool
config HAVE_GPIO_I2C
    bool
config HAVE_GPIO_HARD_PWM
    bool
config HAVE_STRICT_TIMING
    bool
config HAVE_CHIPID
    bool
config HAVE_STEPPER_BOTH_EDGE
    bool
config HAVE_BOOTLOADER_REQUEST
    bool
config HAVE_LIMITED_CODE_SIZE
    bool

config INLINE_STEPPER_HACK
    # Enables gcc to inline stepper_event() into the main timer irq handler
    bool
    depends on HAVE_GPIO
    default y
```
